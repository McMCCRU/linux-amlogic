## drivers/amlogic/media/frame_provider/Kconfig
```kconfig
#
# Amlogic streaming device configuration
#

menu "Video Decoders and Encoders"
	depends on AMLOGIC_MEDIA_VIDEO

config AMLOGIC_MEDIA_VDEC_AVS
	tristate "Amlogic AVS Video Decoder"
	default y
	---help---
	  Driver for avs video decoder.
	  need write more details...
	  write need more.....
	  need more...
	  more...

config AMLOGIC_MEDIA_VDEC_AVS2
	tristate "Amlogic AVS2 Video Decoder"
	default y
	---help---
	  Driver for avs2 video decoder.
	  need write more details...
	  write need more.....
	  need more...
	  more...

config AMLOGIC_MEDIA_VDEC_H264_MVC
	tristate "Amlogic H264MVC Video Decoder"
	default y
	---help---
	  Driver for h264mvc video decoder.
	  need write more details...
	  write need more.....
	  need more...
	  more...

config AMLOGIC_MEDIA_VDEC_H264_MULTI
	tristate "Amlogic H264 Video multi-instance decoding"
	default y
	---help---
	  Driver for h264mvc video multi-instance decoding.
	  need write more details...
	  write need more.....
	  need more...
	  more...


config AMLOGIC_MEDIA_VDEC_H265
	tristate "Amlogic H265 Video Decoder"
	default y
	---help---
	  Driver for h265 video decoder.
	  need write more details...
	  write need more.....
	  need more...
	  more...

config AMLOGIC_MEDIA_VDEC_MJPEG
	tristate "Amlogic Motion JPEG Video Decoder"
	default y
	---help---
	  Driver for motion jpeg video decoder.
	  need write more details...
	  write need more.....
	  need more...
	  more...

config AMLOGIC_MEDIA_VDEC_MPEG12
	tristate "Amlogic MPEG1/2 Video Decoder"
	default y
	---help---
	   Driver for mpeg1/2 video decoder.
	   select for build for support mpeg1 &2
	   ...

config AMLOGIC_MEDIA_VDEC_MPEG2_MULTI
	tristate "Amlogic MPEG1/2 Video multi-instance decoding"
	default y
	---help---
	   Driver for mpeg1/2 video multi-instance decoding.
	   select for build for support mpeg1 &2
	   ...

config AMLOGIC_MEDIA_VDEC_MPEG4
	tristate "Amlogic MPEG4 Video Decoder"
	default y
	---help---
	   Driver for mpeg4 video decoder.
	   select for build for support mpeg4
	   ...


config AMLOGIC_MEDIA_VDEC_MPEG4_MULTI
	tristate "Amlogic MPEG4 Video multi-instance decoding"
	default y
	---help---
	   Driver for mpeg4 video multi-instance decoding.
	   select for build for support mpeg4
	   ...

config AMLOGIC_MEDIA_VDEC_REAL
	tristate "Amlogic Real Video Decoder"
	default y
	---help---
	  Driver for real video decoder.
	  need write more details...
	  write need more.....
	  need more...
	  more...

config AMLOGIC_MEDIA_VDEC_VC1
	tristate "Amlogic VC1 Video Decoder"
	default y
	---help---
	  Driver for vc1 video decoder.
	  need write more details...
	  write need more.....
	  need more...
	  more...

config AMLOGIC_MEDIA_VDEC_VP9
	tristate "Amlogic VP9 Video Decoder"
	default y
	---help---
	  Driver for vp9 video decoder.
	  need write more details...
	  write need more.....
	  need more...
	  more...

config AMLOGIC_MEDIA_VENC_H264
	tristate "Amlogic H264 Video Encoder"
	default y
	---help---
	  Driver for h264 video encoder.
	  need write more details...
	  write need more.....
	  need more...
	  more...

config AMLOGIC_MEDIA_VENC_H265
	tristate "Amlogic H265 Video Encoder"
	default y
	---help---
	  Driver for h265 video encoder.
	  need write more details...
	  write need more.....
	  need more...
	  more...

endmenu
```

## drivers/amlogic/wifi/Kconfig
```kconfig
config AMLOGIC_WIFI
	bool "WiFi support"
	select WIRELESS_EXT
	select WEXT_PRIV
	default n
	help
		select y to support wifi

config AMLOGIC_WIFI_DUMMY
	tristate "Amlogic SDIO WiFi turn on and rescan module"
	depends on AMLOGIC_WIFI
	default m
```
